## br-ext-chip-fujitsu/package/ird-tuner-tc90532/Config.in
```kconfig
config BR2_PACKAGE_IRD_TUNER_TC90532
	bool "ird-tuner-tc90532"
	select BR2_PACKAGE_IRD_TUNER_CORE
	help
	  Toshiba TC90532 復調（＋XC5200C/CXD2818 RF）のクリーン実装（MB86H61 機）。
	  ird-tuner-core の chardev ABI の上に乗る。段階 C（Milestone 2）で実装。
```

## br-ext-chip-renesas/Config.in
```kconfig
source "$BR2_EXTERNAL_IRD_RENESAS_PATH/package/ird-tuner-mxl683/Config.in"
source "$BR2_EXTERNAL_IRD_RENESAS_PATH/package/ird-tuner-emma3sep/Config.in"
```

## br-ext-chip-renesas/package/ird-board-emma3sep/src/Kconfig
```kconfig
config IRD_BOARD_AIRTUNER
	bool "AirTuner boards (EMMA3SEP): LEDs and restart"
	depends on EMMA3SX && GPIOLIB
	select NEW_LEDS
	select LEDS_CLASS
	select LEDS_GPIO
	select LEDS_TRIGGERS
	select LEDS_TRIGGER_DEFAULT_ON
	help
	  The power and status LEDs, and a restart that works: the boards
	  boot from NAND, so the SoC's own restart (a jump to the reset
	  vector) goes nowhere, and they have a self-reset line instead.
	  Inactive on boards the boot loader does not name as an AirTuner.
```

## br-ext-chip-renesas/package/ird-tuner-emma3sep/Config.in
```kconfig
config BR2_PACKAGE_IRD_TUNER_EMMA3SEP
	bool "ird-tuner-emma3sep"
	select BR2_PACKAGE_IRD_TUNER_CORE
	select BR2_PACKAGE_IRD_TUNER_MXL683
	help
	  Renesas EMMA3SEP の TS 取り出し（AV サブシステムのコマンド経路と
	  TS 入力 FIFO のドレイナー）と、機種ごとのフロントエンド（POE-BR100-YB1・
	  SB-TV06-WRIP）を合わせたチューナ。

	  ドライバ本体（src/）はカーネルに組み込む。このパッケージが
	  rootfs に入れるのは起動スクリプト: 所有者の機器の区画から
	  裏 CPU の FW・csd.ko（と、要る機種では復調器のファーム）を
	  実行時に使ってチューナを立ち上げる（どれも配布物には含めない）。
```

## br-ext-chip-renesas/package/ird-tuner-emma3sep/src/Kconfig
```kconfig
config IRD_TUNER_EMMA3SEP
	bool "Renesas EMMA3SEP TS capture (AV sub-CPU commands, TS input FIFOs)"
	depends on EMMA3SX
	help
	  The command path to the firmware of the SoC's AV sub-CPU and the
	  drainer of the transport stream input FIFOs in its data SRAM.
	  Board tuner drivers select this.

config IRD_TUNER_EMMA3SEP_BOARDS
	bool
	select IRD_TUNER_CORE
	select IRD_TUNER_EMMA3SEP
	help
	  The tuner of the EMMA3SEP boards (/dev/irdvideo0): the SoC side is
	  shared, the front end is the one of the board the boot loader
	  names.  Selected by the boards' front ends below.

config IRD_TUNER_YB1
	bool "POE-BR100-YB1 (BMMPX1301) tuner"
	depends on EMMA3SX && I2C
	select IRD_TUNER_EMMA3SEP_BOARDS
	select IRD_TUNER_MXL683
	help
	  The front end of the POE-BR100-YB1: the MXL683 demodulator.
	  Inactive on other boards of the family.

config IRD_TUNER_WRIP
	bool "SB-TV06-WRIP (POE-BR310L-SB1) tuner"
	depends on EMMA3SX && I2C && GPIOLIB
	select IRD_TUNER_EMMA3SEP_BOARDS
	help
	  The front end of the SB-TV06-WRIP: TC90532 demodulator with the
	  MxL601RF and TDA8263HN tuners, terrestrial reception.  Inactive
	  on other boards of the family.
```

## br-ext-chip-renesas/package/ird-tuner-mxl683/Config.in
```kconfig
config BR2_PACKAGE_IRD_TUNER_MXL683
	bool "ird-tuner-mxl683"
	select BR2_PACKAGE_IRD_TUNER_CORE
	help
	  MaxLinear MXL683（ISDB-T 復調器）のクリーン実装。

	  ドライバ本体（src/）はカーネルに組み込む。このパッケージが
	  rootfs に入れるのは ird-mbin＝所有者の機器上のファイルから
	  復調器のファーム（MBIN 容器）を探して取り出す道具。ファーム
	  そのものは配布物に含めない。
```

## br-ext-chip-renesas/package/ird-tuner-mxl683/src/Kconfig
```kconfig
config IRD_TUNER_MXL683
	bool "MaxLinear MXL683 ISDB-T demodulator"
	depends on I2C
	help
	  Cold start, firmware transfer, tuning, lock and C/N of the
	  MXL683.  The firmware itself is supplied at run time from the
	  owner's own device.  Board tuner drivers select this.
```

## br-ext-common/Config.in
```kconfig
source "$BR2_EXTERNAL_IRD_COMMON_PATH/package/ird-tuner-core/Config.in"
source "$BR2_EXTERNAL_IRD_COMMON_PATH/package/ird-config/Config.in"
source "$BR2_EXTERNAL_IRD_COMMON_PATH/package/ird-webui/Config.in"
source "$BR2_EXTERNAL_IRD_COMMON_PATH/package/ird-base-files/Config.in"
source "$BR2_EXTERNAL_IRD_COMMON_PATH/package/ird-addon/Config.in"
source "$BR2_EXTERNAL_IRD_COMMON_PATH/package/openwrt-mtd/Config.in"
```

## br-ext-common/package/ird-addon/Config.in
```kconfig
config BR2_PACKAGE_IRD_ADDON
	bool "ird-addon"
	depends on BR2_PACKAGE_IRD_BASE_FILES
	help
	  OpenIRD: アドオン（実行時パッケージ）のインストーラ。

	  アドオンリポジトリ（HTTPS 上の索引付き静的集合）から .ird を
	  取得し、sha256 と Arch を確かめて永続 overlay に展開する。
	  base（squashfs）には触れず、base が持つパスは上書きしない。
	  受領記録はアドオンごとに /var/lib/ird-addon に置く。

	  BusyBox に wget の HTTPS・awk・sha256sum・tar・gunzip が要る
	  （board の busybox.fragment）。board.conf に ADDON_ARCH= が要る。

	  形式と手順は docs/addon.md。

comment "ird-addon needs ird-base-files (the overlay root)"
	depends on !BR2_PACKAGE_IRD_BASE_FILES
```

## br-ext-common/package/ird-base-files/Config.in
```kconfig
config BR2_PACKAGE_IRD_BASE_FILES
	bool "ird-base-files"
	depends on BR2_PACKAGE_BUSYBOX
	depends on BR2_INIT_BUSYBOX
	help
	  OpenIRD: 共通の rootfs スケルトン。

	  squashfs(RO) を lower、書き込み可能な区画を upper にした
	  overlayfs を preinit が組み立て、pivot_root して BusyBox
	  init に渡す（OpenWrt と同じ形）。upper がマウントできない
	  ときは tmpfs にフォールバックして起動する。

	  inittab / fstab / ネットワーク起動スクリプトもここに入る。

comment "ird-base-files needs BusyBox as init"
	depends on !BR2_INIT_BUSYBOX || !BR2_PACKAGE_BUSYBOX
```

## br-ext-common/package/ird-config/Config.in
```kconfig
config BR2_PACKAGE_IRD_CONFIG
	bool "ird-config"
	help
	  OpenIRD: ird-config（プレースホルダ。実装は後続マイルストーン）。
```

## br-ext-common/package/ird-pcsc/Config.in
```kconfig
config BR2_PACKAGE_IRD_PCSC
	bool "ird-pcsc"
	depends on BR2_TOOLCHAIN_HAS_THREADS
	depends on BR2_STATIC_LIBS
	help
	  OpenIRD: カードリーダー（/dev/irdcard0）を PC/SC で使うための
	  pcsc-lite（pcscd と libpcsclite）。

	  rootfs が静的リンクなので、pcsc-lite を静的ドライバの作り
	  （PCSCLITE_STATIC_DRIVER）でビルドし、OpenIRD の IFD ハンドラ
	  （ifd-irdcard）を pcscd に組み込む。機器の上のプログラムは
	  libpcsclite.a（SDK に入る）を静的にリンクして pcscd と話す。
	  確かめ用の ird-pcsc も入る。

	  /dev/irdcard0 の無い機種では pcscd は起動しない。
	  仕様は docs/specs/emma3sep-card-reader.md。

comment "ird-pcsc needs a static toolchain with threads"
	depends on !BR2_TOOLCHAIN_HAS_THREADS || !BR2_STATIC_LIBS
```

## br-ext-common/package/ird-tuner-core/Config.in
```kconfig
config BR2_PACKAGE_IRD_TUNER_CORE
	bool "ird-tuner-core"
	help
	  OpenIRD のチューナ ABI 契約＝px4_drv 互換 chardev。

	  ドライバ本体（src/）はカーネルに組み込む（make kernel が
	  カーネルツリーへ重ねる）。このパッケージが rootfs に入れるのは、
	  その chardev を話す確認用クライアント ird-rec だけ。
	  機種別のドライバ（ird-tuner-mxl683 / ird-tuner-emma3sep ほか）が
	  この ABI の上に乗る。
```

## br-ext-common/package/ird-tuner-core/src/Kconfig
```kconfig
config IRD_TUNER_CORE
	bool "OpenIRD tuner core (px4_drv-compatible character device)"
	select CRC32
	help
	  The character device OpenIRD tuners appear as (/dev/irdvideoN):
	  the ABI of px4_drv, which recpt1 and recisdb already speak.
	  Board tuner drivers select this.
```

## br-ext-common/package/ird-webui/Config.in
```kconfig
config BR2_PACKAGE_IRD_WEBUI
	bool "ird-webui"
	help
	  OpenIRD: ird-webui（プレースホルダ。実装は後続マイルストーン）。
```

## br-ext-common/package/openwrt-mtd/Config.in
```kconfig
config BR2_PACKAGE_OPENWRT_MTD
	bool "openwrt-mtd"
	help
	  OpenWrt の mtd ユーティリティ（package/system/mtd）。
	  MTD 区画の消去・書き込み・検証（write/erase/verify/jffs2write）を
	  行う。対象は /proc/mtd の区画名または /dev/mtdN で指定する。
	  OpenIRD のファーストエイド rootfs と sysupgrade 系の書き込み口。

	  依存の libubox からは md5 実装だけを取り込み、静的リンクで
	  単体バイナリにする（Buildroot の libubox は共有ライブラリ必須）。

	  https://github.com/openwrt/openwrt/tree/main/package/system/mtd
```
